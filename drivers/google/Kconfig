## drivers/google/Kconfig
```kconfig
menuconfig GOOGLE_DRIVER
	tristate "Google Drivers"
	default n
	help
	  Google Drivers

if GOOGLE_DRIVER

config GOOGLE_DRIVER_MODIFY
	tristate "Google Driver Modify"
	default y
	help
	  Set this flag to apply Google's modifications on other linux kernel
	  drivers.

config GOOGLE_USB_POWER_MONITOR
	tristate "USB Power Monitor"
	depends on OF && HWMON && THERMAL && THERMAL_OF
	help
	  Sabrina USB power monitor

endif # GOOGLE_DRIVER
```
